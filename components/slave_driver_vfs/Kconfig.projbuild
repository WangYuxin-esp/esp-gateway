## components/slave_driver_vfs/Kconfig.projbuild
```kconfig
menu "VFS_DEV_BUS"

choice VFS_DEV
    prompt "communicate device for VFS"
    default VFS_BASE_ON_SPI

config VFS_BASE_ON_SPI
    bool "VFS through SPI"
    depends on !IDF_TARGET_ESP32
    help
        The MCU can transmit data through SPI bus.
config VFS_BASE_ON_SDIO
    bool "VFS through SDIO"
    depends on IDF_TARGET_ESP32
    help
        The MCU can transmit data through SDIO bus. 
endchoice

config VFS_BASE_PATH
    string "SPI path prefix"
    default "/dev/spi_io" if VFS_BASE_ON_SPI
    default "/dev/sdio" if VFS_BASE_ON_SDIO
    help
        file path prefix associated with the filesystem. Must be a zero-terminated C string

choice SPI_TRANSMIT
    prompt "communicate way for SPI transmit"
    depends on VFS_BASE_ON_SPI
    default SPI_SINGLE_MODE

config SPI_SINGLE_MODE
    bool "Standard SPI"
    help
        The MCU can transmit data through MOSI or MISO line.
config SPI_DUAL_MODE
    bool "Dual SPI"
    help
        The MCU can transmit data through MOSI and MISO line. 
config SPI_QUAD_MODE
    bool "Quad SPI"
    depends on !IDF_TARGET_ESP8266
    help
        Quad SPI goes beyond dual SPI, adding two more I/O lines and sends 4 data bits per clock cycle.
endchoice

menu "spi gpio settings"
    depends on VFS_BASE_ON_SPI
    config SPI_SCLK_PIN
        int "SPI sclk pin"
        default 15 if IDF_TARGET_ESP32S2
        default 6 if IDF_TARGET_ESP32C3
        depends on !IDF_TARGET_ESP8266
    config SPI_MOSI_PIN
        int "SPI mosi pin"
        default 13 if IDF_TARGET_ESP32S2
        default 7 if IDF_TARGET_ESP32C3
        depends on !IDF_TARGET_ESP8266
    config SPI_MISO_PIN
        int "SPI miso pin"
        default 12 if IDF_TARGET_ESP32S2
        default 2 if IDF_TARGET_ESP32C3
        depends on !IDF_TARGET_ESP8266
    config SPI_CS_PIN
        int "SPI cs pin"
        default 14 if IDF_TARGET_ESP32S2
        default 10 if IDF_TARGET_ESP32C3
        depends on !IDF_TARGET_ESP8266
    config SPI_HANDSHAKE_PIN
        int "SPI handshake pin for slave send"
        default 5 if IDF_TARGET_ESP32S2
        default 3 if IDF_TARGET_ESP32C3
        default 4 if IDF_TARGET_ESP8266
    config SPI_WP_PIN
        int "SPI WP pin(quad spi)"
        default 16 if IDF_TARGET_ESP32S2
        default 8 if IDF_TARGET_ESP32C3
        depends on SPI_QUAD_MODE
    config SPI_HD_PIN
        int "SPI HD pin(quad spi)"
        default 17 if IDF_TARGET_ESP32S2
        default 9 if IDF_TARGET_ESP32C3
        depends on SPI_QUAD_MODE
endmenu

menu "spi order"
    depends on VFS_BASE_ON_SPI
    config MOSI_BYTE_LITTLE_ENDIAN
        bool "MOSI use Little endian byte order"
        depends on IDF_TARGET_ESP8266
        default n
        help 
            if enable, MOSI will use little endian instead of big endian byte order

    config MISO_BYTE_LITTLE_ENDIAN
        bool "MISO use Little endian byte order"
        depends on IDF_TARGET_ESP8266
        default n
        help 
            if enable, MISO will use little endian instead of big endian byte order

    config MOSI_BIT_ORDER_LSB
        bool "MOSI bit use LSB first"
        default n
        help 
            if enable, MOSI will use LSB first instead of MSB bit order

    config MISO_BIT_ORDER_LSB
        bool "MISO bit use LSB first"
        default n
        help 
            if not enable, MISO will use LSB first instead of MSB bit order
endmenu

menu "spi settings"
    depends on VFS_BASE_ON_SPI
    config WORK_IN_MASTER
        bool "Work in master"
        default n
        help 
            if not enable, SPI will work in slave

    config SPI_NUM
        int "SPI number"
        default 1
        range 1 2 if !IDF_TARGET_ESP8266
        range 1 1 if IDF_TARGET_ESP8266

    choice SPI_DATA_TRANSMIT
        prompt "Data communicate way for SPI transmit"
        depends on VFS_BASE_ON_SPI
        default SPI_STREAM_MODE

    config SPI_STREAM_MODE
        bool "Stream mode"
        help
            Data is transmitted as a stream, allowing multiple packets in the application to be sent at once
    config SPI_PACKET_MODE
        bool "Packet mode"
        help
            Data is sent in strict accordance with the length of data transmitted by the application.
    endchoice

    config SPI_MODE
        int "SPI mode"
        default 0
        range 0 3
        depends on VFS_BASE_ON_SPI
    config TX_STREAM_BUFFER_SIZE
        int "TX stream buffer size"
        default 4096
        range 1024 8192
    config RX_STREAM_BUFFER_SIZE
        int "RX stream buffer size"
        default 4096
        range 1024 8192
endmenu

endmenu
```
